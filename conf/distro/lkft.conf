## conf/distro/lkft.conf
```bitbake
require conf/distro/include/rpb.inc

DISTRO_NAME = "Linux-Kernel-Functional-Testing"
DISTRO_FEATURES_remove = "opengl wayland"

CMDLINE_remove = "quiet"

GCCVERSION = "7.%"

PREFERRED_PROVIDER_virtual/kernel ?= "linux-generic-mainline"
MACHINE_HWCODECS_intel-corei7-64 = ""
MACHINE_HWCODECS_intel-core2-32 = ""
IMAGE_FSTYPES_remove = "ext4 iso wic wic.gz"
RDEPENDS_packagegroup-rpb_remove = "docker"

# For qemu arm64
IMAGE_FSTYPES_juno_append = " ext4.gz"
EXTRA_IMAGECMD_juno_ext4 += " -L rootfs "

# `fold' is needed for recent kernels (4.20+)
HOSTTOOLS += "fold"

# Read kernel parameters for LKFT, if there's any
include conf/lkft-kernel.conf

INHERIT += "own-mirrors"
BB_GENERATE_MIRROR_TARBALLS = "1"
SOURCE_MIRROR_URL = "http://alago/lkft-oe-caches/downloads/"
SSTATE_MIRRORS = "file://.* http://alago/lkft-oe-caches/sstate-cache/PATH"
```
